## Kconfig
```kconfig
config AIVOICE_EN_MENU
    bool "Enable AIVoice"
    select AIVOICE_EN if WHC_HOST || WHC_NONE
    select TFLITE_MICRO_EN if WHC_HOST || WHC_NONE

if AIVOICE_EN_MENU
    choice
        prompt "Select AFE Resource"
        default AFE_RES_2MIC50MM_MENU

        config AFE_RES_1MIC_MENU
            bool "afe_res_1mic"
            select AFE_RES_1MIC if WHC_HOST || WHC_NONE

        config AFE_RES_2MIC30MM_MENU
            bool "afe_res_2mic30mm"
            select AFE_RES_2MIC30MM if WHC_HOST || WHC_NONE

        config AFE_RES_2MIC50MM_MENU
            bool "afe_res_2mic50mm"
            select AFE_RES_2MIC50MM if WHC_HOST || WHC_NONE

        config AFE_RES_2MIC70MM_MENU
            bool "afe_res_2mic70mm"
            select AFE_RES_2MIC70MM if WHC_HOST || WHC_NONE

        config AFE_RES_CIRCLE3MIC50MM_MENU
            bool "afe_res_3mic50mm"
            select AFE_RES_CIRCLE3MIC50MM if WHC_HOST || WHC_NONE
    endchoice

    choice
        prompt "Select VAD Resource"
        default VAD_V7_200K_MENU

        config VAD_V7_200K_MENU
            bool "vad_v7_200K"
            select VAD_V7_200K if WHC_HOST || WHC_NONE

        config VAD_V8_60K_MENU
            bool "vad_v8_60K"
            select VAD_V8_60K if WHC_HOST || WHC_NONE

        config VAD_V9_208K_MENU
            bool "vad_v9_208K"
            select VAD_V9_208K if WHC_HOST || WHC_NONE

        config VAD_V11_208K_MENU
            bool "vad_v11_208K"
            select VAD_V11_208K if WHC_HOST || WHC_NONE
    endchoice

    choice
        prompt "Select KWS Resource"
        default KWS_XIAOQIANGXIAOQIANG_NIHAOXIAOQIANG_V4_300K_MENU

        config KWS_XIAOQIANGXIAOQIANG_NIHAOXIAOQIANG_V4_300K_MENU
            bool "kws_xiaoqiangxiaoqiang_nihaoxiaoqiang_v4_300K"
            select KWS_XIAOQIANGXIAOQIANG_NIHAOXIAOQIANG_V4_300K if WHC_HOST || WHC_NONE

        config KWS_XIAOQIANGXIAOQIANG_NIHAOXIAOQIANG_V5_125K_MENU
            bool "kws_xiaoqiangxiaoqiang_nihaoxiaoqiang_v5_125K"
            select KWS_XIAOQIANGXIAOQIANG_NIHAOXIAOQIANG_V5_125K if WHC_HOST || WHC_NONE

        config KWS_CN_CUSTOMIZED_V3_750K_MENU
            bool "kws_cn_customized_v3_750K"
            select KWS_CN_CUSTOMIZED_V3_750K if WHC_HOST || WHC_NONE

        config KWS_CN_CUSTOMIZED_V5_886K_MENU
            bool "kws_cn_customized_v5_886K"
            select KWS_CN_CUSTOMIZED_V5_886K if WHC_HOST || WHC_NONE
    endchoice

    choice
        prompt "Select ASR Resource"
        default ASR_CN_V8_2M_MENU

        config ASR_CN_V8_2M_MENU
            bool "asr_cn_v8_2M"
            select ASR_CN_V8_2M if WHC_HOST || WHC_NONE

        config ASR_CN_V10_1M_MENU
            bool "asr_cn_v10_1M"
            select ASR_CN_V10_1M if WHC_HOST || WHC_NONE
    endchoice
endif

config AIVOICE_EN
    bool

config AFE_RES_1MIC
    bool

config AFE_RES_2MIC30MM
    bool

config AFE_RES_2MIC50MM
    bool

config AFE_RES_2MIC70MM
    bool

config AFE_RES_CIRCLE3MIC50MM
    bool

config VAD_V7_200K
    bool

config VAD_V8_60K
    bool

config VAD_V9_208K
    bool

config VAD_V11_208K
    bool

config KWS_XIAOQIANGXIAOQIANG_NIHAOXIAOQIANG_V4_300K
    bool

config KWS_XIAOQIANGXIAOQIANG_NIHAOXIAOQIANG_V5_125K
    bool

config KWS_CN_CUSTOMIZED_V3_750K
    bool

config KWS_CN_CUSTOMIZED_V5_886K
    bool

config ASR_CN_V8_2M
    bool

config ASR_CN_V10_1M
    bool
```
